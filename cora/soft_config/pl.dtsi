/*
 * CAUTION: This file is automatically generated by Xilinx.
 * Version: XSCT 2018.3
 * Today is: Sun Jul 28 15:01:29 2019
 */


/ {
	amba_pl: amba_pl {
		#address-cells = <1>;
		#size-cells = <1>;
		compatible = "simple-bus";
		ranges ;

		htif@43c00000 {
			/* This is a place holder node for a custom IP, user may need to update the entries */
			compatible = "generic-uio", "uio", "uio_pdrv";	
			reg = <0x43c00000 0x1000>;
		};
	};
};
